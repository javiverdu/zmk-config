/*
 * This file overrides the default settings from the zmk-nice-oled module.
 */

/* * Find the ssd1306 node that the module created.
 * The & symbol means we are referencing an existing node.
 */
&ssd1306 {
    /* * This is the fix:
     * Override the module's default height = <32> and set it to <64>.
     */
    height = <64>;
};
