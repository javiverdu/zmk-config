## config/boards/shields/corne_dongle/Kconfig.defconfig
```kconfig
# SPDX-License-Identifier: MIT

if SHIELD_CORNE_DONGLE

config ZMK_KEYBOARD_NAME
    default "Corne Dongle"

config ZMK_SPLIT
    default y

config ZMK_SPLIT_ROLE_CENTRAL
    default y

config ZMK_USB
    default y

if ZMK_DISPLAY

config I2C
    default y

config SSD1306
    default y

# El dongle va por USB: cola dedicada para que las animaciones no bloqueen
# el hilo principal.
choice ZMK_DISPLAY_WORK_QUEUE
    default ZMK_DISPLAY_WORK_QUEUE_DEDICATED
endchoice

endif # ZMK_DISPLAY

endif
```

## config/west.yml
```yaml
manifest:
  remotes:
    - name: zmkfirmware
      url-base: https://github.com/zmkfirmware
    - name: mctechnology17
      url-base: https://github.com/mctechnology17
    - name: zzeneg # requerido para el modulo Raw HID
      url-base: https://github.com/zzeneg
    - name: srwi # requerido para el modulo KeyPeek
      url-base: https://github.com/srwi
  projects:
    - name: zmk
      remote: zmkfirmware
      revision: v0.3 # fijado: main migro a Zephyr 4.1/hwmv2 y renombro nice_nano_v2
      import: app/west.yml
    - name: zmk-nice-oled
      remote: mctechnology17
      revision: main
    - name: zmk-raw-hid # modulo Raw HID (shield raw_hid_adapter)
      remote: zzeneg
      revision: main
    - name: zmk-keypeek-layer-notifier # modulo KeyPeek
      remote: srwi
      revision: master
#    - name: zmk-oled-adapter
#      remote: mctechnology17
#      revision: main
  self:
    path: config
```
