/*
 * ZMK Overlay for 128x64 SSD1306
 *
 * FIX ATTEMPT 2:
 * 1. Setting I2C speed to 100kHz (I2C_BITRATE_STANDARD)
 * 2. Keeping 'com-sequential'
 * 3. Fixing typo in 'chosen' block
 */

/* 1. Modify the I2C bus: set speed and add display */
&pro_micro_i2c {
    status = "okay";
    # clock-frequency = <I2C_BITRATE_STANDARD>; /* 100kHz */

    /* 2. Define the display as a child of the I2C bus */
    oled_128x64: ssd1306@3c {
        compatible = "solomon,ssd1306fb";
        reg = <0x3c>;
        width = <128>;
        height = <64>;
        segment-offset = <0>;
        page-offset = <0>;
        display-offset = <0>;
        multiplex-ratio = <63>;
        prechargep = <0x22>;
        segment-remap;   /* Remove if mirrored */
        com-invdir;      /* Remove if upside-down */
        
        /* Keep this from the last attempt */
        com-sequential;
        inversion-on;
    };
};

/* 3. Delete the default board display */
/delete-node/ &oled;

/* 4. Tell ZMK to use our new display (with typo fixed) */
/ {
    chosen {
        zephyr,display = &oled_128x64;
    };
};
// vim: filetype=dts fdm=marker:
